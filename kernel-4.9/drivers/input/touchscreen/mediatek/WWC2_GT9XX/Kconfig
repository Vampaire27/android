## kernel-4.9/drivers/input/touchscreen/mediatek/WWC2_GT9XX/Kconfig
```kconfig
#
# Touchscreen driver configuration
#
# menu "GT9 Touchscreen Config"
#	depends on TOUCHSCREEN_MTK_GT9XX


config GT9XX_FIRMWARE
	string "GT9 firmawre group"
	default "firmware0"

config GT9XX_CONFIG
	string "GT9 config data group"
	default "config0"

config GTP_POWER_CTRL_SLEEP
	bool "GT9 power cntrol while sleep"
	help
	    Say Y here if you have GT9 touch panel GTP_POWER_CTRL_SLEEP.

	    If unsure, say N.

	    Will disable power while device suspend. if you support gesture
	    wake up feature, do not enable this feature.

#endmenu
```

## kernel-4.9/drivers/misc/mediatek/sensors-1.0/accelerometer/mc34xx/Kconfig
```kconfig
config MTK_MC34XX
	tristate "MC34XX for MediaTek package"
	default n
	help
	  It support different accelerometer sensor.
          If this option is set,
	  it will support
          MC34XX Accelerometer.
```

## kernel-4.9/drivers/misc/mediatek/wwc2/Kconfig
```kconfig
config ACC_SIGNAL
	bool "IS ACC ON or ACC OFF signal SUPPORT"
	default n
	help
	  Is ACC signal

config ACC_SIGNAL_TO_CONTROL_BACKLIHGT_SUPPORT
	bool "if acc signal to control the lcm backlight"
	default n
	help
	  Is acc signal to control the lcm backlight

config ACC_SIGNAL_REPORT_KEY
	bool "if acc signal to report the input key (KEY_WAKEUP and KEY_SLEEP) to upper layer"
	default n
	help
	  Is acc signal to report the input key

config BACKCAMERA_SIGNAL
	bool "IS BACK CAMERA signal SUPPORT"
	default n
	help
	  Is back camera signal
	  
config WWC2_VIDEO_RECORD
	bool "IS WWC2 VIDEO RECORD support"
 	default n
 	help
 	  IS WWC2 VIDEO RECORD

config WWC2_CAMERA_COMBINE
	bool "IS WWC2 CAMERA COMBINE support"
	default n
	help
		IS WWC2 CAMERA COMBINE
```
